## panther_sdk/openwrt/package/alexa/Config.in
```kconfig
if PACKAGE_alexa
comment "Far field support"

choice
	prompt "Far field support"
	default ALEXA_NOT_SUPPORT_FF

	config ALEXA_NOT_SUPPORT_FF
	bool "not_support_FF"
	
	config ALEXA_SUPPORT_FF
	bool "support_FF"

endchoice

endif
```

## panther_sdk/openwrt/package/legacy/ffmpeg/Config.in
```kconfig
menu "Configuration"
	depends on PACKAGE_libffmpeg-custom

config FFMPEG_CUSTOM_PATENTED
	bool "Include patented codecs and technologies"
	default BUILD_PATENTED

comment "Profiles ---"

config FFMPEG_CUSTOM_IPCAM_SUPPORT
	bool "Include support for IPCam"
	select FFMPEG_CUSTOM_DECODER_h264
	select FFMPEG_CUSTOM_DECODER_mjpeg
	select FFMPEG_CUSTOM_DECODER_pcm_s16le
	select FFMPEG_CUSTOM_ENCODER_mjpeg
	select FFMPEG_CUSTOM_ENCODER_mpeg4
	select FFMPEG_CUSTOM_ENCODER_pcm_s16le
	select FFMPEG_CUSTOM_PARSER_mjpeg
	select FFMPEG_CUSTOM_PARSER_h264
	select FFMPEG_CUSTOM_DEMUXER_ffm
	select FFMPEG_CUSTOM_MUXER_mpjpeg
	select FFMPEG_CUSTOM_MUXER_matroska
	select FFMPEG_CUSTOM_FILTER_copy
	select FFMPEG_CUSTOM_INDEV_v4l2
	select FFMPEG_CUSTOM_INDEV_alsa
	select FFMPEG_CUSTOM_PROTOCOL_file

config FFMPEG_CUSTOM_WIFISPK_SUPPORT
	bool "Include support for wifi speaker"
	select FFMPEG_CUSTOM_MUXER_amr
	select FFMPEG_CUSTOM_DECODER_amrnb
	select FFMPEG_CUSTOM_DECODER_amrwb
	select FFMPEG_CUSTOM_DECODER_ape
	select FFMPEG_CUSTOM_DECODER_flac
	select FFMPEG_CUSTOM_DECODER_mp3
	select FFMPEG_CUSTOM_DECODER_mp3float
	select FFMPEG_CUSTOM_DECODER_pcm_s16be
	select FFMPEG_CUSTOM_DECODER_pcm_s16le
	select FFMPEG_CUSTOM_DECODER_wavpack
	select FFMPEG_CUSTOM_DECODER_wmav1
	select FFMPEG_CUSTOM_DECODER_wmav2
	select FFMPEG_CUSTOM_DECODER_wmapro
	select FFMPEG_CUSTOM_DECODER_wmalossless
	select FFMPEG_CUSTOM_DECODER_zlib
	select FFMPEG_CUSTOM_DEMUXER_aac
	select FFMPEG_CUSTOM_DEMUXER_amr
	select FFMPEG_CUSTOM_DEMUXER_ape
	select FFMPEG_CUSTOM_DEMUXER_flac
	select FFMPEG_CUSTOM_DEMUXER_mp3
	select FFMPEG_CUSTOM_DEMUXER_sdp
	select FFMPEG_CUSTOM_DEMUXER_wav
	select FFMPEG_CUSTOM_DEMUXER_hls
	select FFMPEG_CUSTOM_DEMUXER_rtsp
	select FFMPEG_CUSTOM_PROTOCOL_file
	select FFMPEG_CUSTOM_PROTOCOL_hls
	select FFMPEG_CUSTOM_PROTOCOL_rtp
	select FFMPEG_CUSTOM_PROTOCOL_tcp
	select FFMPEG_CUSTOM_PROTOCOL_udp
	select FFMPEG_CUSTOM_PROTOCOL_http
	select FFMPEG_CUSTOM_PROTOCOL_https
	select FFMPEG_CUSTOM_PARSER_aac
	select FFMPEG_CUSTOM_PARSER_mpegaudio
	select FFMPEG_CUSTOM_PARSER_flac

config FFMPEG_CUSTOM_FFSERVER_SUPPORT
	bool "Include support for ffserver (FFmpeg streaming server)"
	select FFMPEG_CUSTOM_MUXER_ffm
	select FFMPEG_CUSTOM_DEMUXER_ffm
	select FFMPEG_CUSTOM_DEMUXER_rtsp
	select FFMPEG_CUSTOM_PROTOCOL_rtp

#config FFMPEG_CUSTOM_LIBDLNA_SUPPORT
#	bool "Include support for libdlna/ushare"
#	depends on FFMPEG_CUSTOM_PATENTED
#	select FFMPEG_CUSTOM_DECODER_ac3
#	select FFMPEG_CUSTOM_DECODER_atrac3
#	select FFMPEG_CUSTOM_DECODER_h264
#	select FFMPEG_CUSTOM_DECODER_jpegls
#	select FFMPEG_CUSTOM_DECODER_mp3
#	select FFMPEG_CUSTOM_DECODER_mpeg1video
#	select FFMPEG_CUSTOM_DECODER_mpeg2video
#	select FFMPEG_CUSTOM_DECODER_mpeg4
#	select FFMPEG_CUSTOM_DECODER_mpegvideo
#	select FFMPEG_CUSTOM_DECODER_wmav1
#	select FFMPEG_CUSTOM_DECODER_wmav2
#	select FFMPEG_CUSTOM_DECODER_png
#	select FFMPEG_CUSTOM_DEMUXER_ac3
#	select FFMPEG_CUSTOM_DEMUXER_h264
#	select FFMPEG_CUSTOM_DEMUXER_mp3
#	select FFMPEG_CUSTOM_DEMUXER_mpegvideo

config FFMPEG_CUSTOM_MINIDLNA_SUPPORT
	bool "Include support for minidlna"
	depends on FFMPEG_CUSTOM_PATENTED
	select FFMPEG_CUSTOM_DEMUXER_aac
	select FFMPEG_CUSTOM_DEMUXER_flv
	select FFMPEG_CUSTOM_DEMUXER_ac3
	select FFMPEG_CUSTOM_DEMUXER_avi
	select FFMPEG_CUSTOM_DEMUXER_flac
	select FFMPEG_CUSTOM_DEMUXER_h264
	select FFMPEG_CUSTOM_DEMUXER_matroska
	select FFMPEG_CUSTOM_DEMUXER_mov
	select FFMPEG_CUSTOM_DEMUXER_mp3
	select FFMPEG_CUSTOM_DEMUXER_mpegvideo
	select FFMPEG_CUSTOM_DEMUXER_mpegts
	select FFMPEG_CUSTOM_DEMUXER_mpegps
	select FFMPEG_CUSTOM_PROTOCOL_file

comment "Encoders ---"

config FFMPEG_CUSTOM_ENCODER_mjpeg
	bool "Motion JPEG"

config FFMPEG_CUSTOM_ENCODER_ac3
	bool "AC3"
	depends on FFMPEG_CUSTOM_PATENTED
	select FFMPEG_CUSTOM_PARSER_ac3

config FFMPEG_CUSTOM_ENCODER_flv
	bool "FLV"

config FFMPEG_CUSTOM_ENCODER_jpegls
	bool "JPEG-LS"

config FFMPEG_CUSTOM_ENCODER_mpeg1video
	bool "MPEG-1 Video"

config FFMPEG_CUSTOM_ENCODER_mpeg2video
	bool "MPEG-2 Video"
	depends on FFMPEG_CUSTOM_PATENTED

config FFMPEG_CUSTOM_ENCODER_mpeg4
	bool "MPEG-4"
	depends on FFMPEG_CUSTOM_PATENTED

config FFMPEG_CUSTOM_ENCODER_pcm_s16be
	bool "PCM signed 16-bit big-endian"

config FFMPEG_CUSTOM_ENCODER_pcm_s16le
	bool "PCM signed 16-bit little-endian"

config FFMPEG_CUSTOM_ENCODER_png
	bool "PNG"
	select FFMPEG_CUSTOM_ENCODER_zlib

config FFMPEG_CUSTOM_ENCODER_vorbis
	bool "Vorbis"

config FFMPEG_CUSTOM_ENCODER_zlib
	bool "Zlib"

comment "Decoders ---"
config FFMPEG_CUSTOM_DECODER_ape
	bool "APE"

config FFMPEG_CUSTOM_DECODER_mjpeg
	bool "Motion JPEG"

config FFMPEG_CUSTOM_DECODER_flv
	bool "FLV"
	depends on FFMPEG_CUSTOM_PATENTED
	select FFMPEG_CUSTOM_PARSER_flv

config FFMPEG_CUSTOM_DECODER_aac
	bool "AAC (Advanced Audio Coding)"
	depends on FFMPEG_CUSTOM_PATENTED
	select FFMPEG_CUSTOM_PARSER_aac
	
config FFMPEG_CUSTOM_SELECT_adpcm
	bool "ADPCM (multiple types)"	
	
config FFMPEG_CUSTOM_DECODER_aac_latm
	bool "AAC_LATM"
	depends on FFMPEG_CUSTOM_PATENTED
	select FFMPEG_CUSTOM_PARSER_aac_latm

config FFMPEG_CUSTOM_DECODER_ac3
	bool "AC3"
	depends on FFMPEG_CUSTOM_PATENTED
	select FFMPEG_CUSTOM_PARSER_ac3

config FFMPEG_CUSTOM_DECODER_alac
	bool "ALAC"

config FFMPEG_CUSTOM_DECODER_amrnb
	bool "AMR-NB"
	select FFMPEG_CUSTOM_DEMUXER_amr

config FFMPEG_CUSTOM_DECODER_amrwb
	bool "AMR-WB"
	select FFMPEG_CUSTOM_DEMUXER_amr

config FFMPEG_CUSTOM_DECODER_ape
	bool "APE"
	
config FFMPEG_CUSTOM_DECODER_atrac3
	bool "ATRAC3"
	depends on FFMPEG_CUSTOM_PATENTED

config FFMPEG_CUSTOM_DECODER_flac
	bool "FLAC"
	select FFMPEG_CUSTOM_PARSER_flac

config FFMPEG_CUSTOM_DECODER_gif
	bool "GIF"

config FFMPEG_CUSTOM_DECODER_h264
	bool "H.264"
	depends on FFMPEG_CUSTOM_PATENTED

config FFMPEG_CUSTOM_DECODER_jpegls
	bool "JPEG-LS"

config FFMPEG_CUSTOM_DECODER_mp2
	bool "MP2 (MPEG Audio Layer 2)"
	depends on FFMPEG_CUSTOM_PATENTED

config FFMPEG_CUSTOM_DECODER_mp3
	bool "MP3 (MPEG Audio Layer 2)"
	depends on FFMPEG_CUSTOM_PATENTED
	
config FFMPEG_CUSTOM_DECODER_mp3float
	bool "MP3FLOAT (MPEG Audio Layer 2)"
	depends on FFMPEG_CUSTOM_PATENTED
	
config FFMPEG_CUSTOM_DECODER_mp3adu
	bool "MP3ADU (MPEG Audio Layer 2)"
	depends on FFMPEG_CUSTOM_PATENTED
	
config FFMPEG_CUSTOM_DECODER_mp3adufloat
	bool "MP3ADUFLOAT (MPEG Audio Layer 2)"
	depends on FFMPEG_CUSTOM_PATENTED
	
config FFMPEG_CUSTOM_DECODER_mp3on4
	bool "MP3ON4ADU (MPEG Audio Layer 2)"
	depends on FFMPEG_CUSTOM_PATENTED
	
config FFMPEG_CUSTOM_DECODER_mp3on4float
	bool "MP3ON4FLOAT (MPEG Audio Layer 2)"
	depends on FFMPEG_CUSTOM_PATENTED

config FFMPEG_CUSTOM_DECODER_mpegvideo
	bool "MPEG Video"

config FFMPEG_CUSTOM_DECODER_mpeg1video
	bool "MPEG-1 Video"

config FFMPEG_CUSTOM_DECODER_mpeg2video
	bool "MPEG-2 Video"
	depends on FFMPEG_CUSTOM_PATENTED

config FFMPEG_CUSTOM_DECODER_mpeg4
	bool "MPEG-4"
	depends on FFMPEG_CUSTOM_PATENTED

config FFMPEG_CUSTOM_DECODER_mpc7
	bool "Musepack 7"
	select FFMPEG_CUSTOM_DEMUXER_mpc

config FFMPEG_CUSTOM_DECODER_mpc8
	bool "Musepack 8"
	select FFMPEG_CUSTOM_DEMUXER_mpc8

config FFMPEG_CUSTOM_DECODER_opus
	bool "Opus"

config FFMPEG_CUSTOM_DECODER_pcm_s16be
	bool "PCM signed 16-bit big-endian"

config FFMPEG_CUSTOM_DECODER_pcm_s16le
	bool "PCM signed 16-bit little-endian"

config FFMPEG_CUSTOM_DECODER_png
	bool "PNG"
	select FFMPEG_CUSTOM_DECODER_zlib

config FFMPEG_CUSTOM_DECODER_vorbis
	bool "Vorbis"
	select FFMPEG_CUSTOM_DEMUXER_ogg

config FFMPEG_CUSTOM_DECODER_wavpack
	bool "Wavpack"

config FFMPEG_CUSTOM_DECODER_wmav1
	bool "WMAv1"
	depends on FFMPEG_CUSTOM_PATENTED

config FFMPEG_CUSTOM_DECODER_wmav2
	bool "WMAv2"
	depends on FFMPEG_CUSTOM_PATENTED
	
config FFMPEG_CUSTOM_DECODER_wmapro
	bool "WMAPRO"
	depends on FFMPEG_CUSTOM_PATENTED
	
config FFMPEG_CUSTOM_DECODER_wmavoice
	bool "WMAVOICE"
	depends on FFMPEG_CUSTOM_PATENTED
	
config FFMPEG_CUSTOM_DECODER_wmalossless
	bool "WMALOSSLESS"
	depends on FFMPEG_CUSTOM_PATENTED

config FFMPEG_CUSTOM_DECODER_cook
	bool "cook"

config FFMPEG_CUSTOM_DECODER_zlib
	bool "Zlib"

comment "Muxers ---"

config FFMPEG_CUSTOM_MUXER_mpjpeg
	bool "Multipart JPEG"

config FFMPEG_CUSTOM_MUXER_matroska
	bool "Matroska"

config FFMPEG_CUSTOM_MUXER_ac3
	bool "AC3"
	depends on FFMPEG_CUSTOM_PATENTED
	
config FFMPEG_CUSTOM_MUXER_adts
	bool "ADTS"
	
select FFMPEG_CUSTOM_MUXER_amr
	bool "AMR"
	depends on FFMPEG_CUSTOM_PATENTED

config FFMPEG_CUSTOM_MUXER_flv
	bool "FLV"

config FFMPEG_CUSTOM_MUXER_ffm
	bool "FFM (ffserver live feed)"

config FFMPEG_CUSTOM_MUXER_h264
	bool "H.264"
	depends on FFMPEG_CUSTOM_PATENTED

config FFMPEG_CUSTOM_MUXER_mp3
	bool "MP3 (MPEG Audio Layer 3)"

config FFMPEG_CUSTOM_MUXER_mp4
	bool "MP4"

config FFMPEG_CUSTOM_MUXER_mpeg1video
	bool "MPEG-1 Video"

config FFMPEG_CUSTOM_MUXER_mpeg2video
	bool "MPEG-2 Video"

config FFMPEG_CUSTOM_MUXER_mpegts
	bool "MPEG-2 (TS)"

config FFMPEG_CUSTOM_MUXER_ogg
	bool "Ogg"

config FFMPEG_CUSTOM_MUXER_rtp
	bool "RTP"

comment "Demuxers ---"

config FFMPEG_CUSTOM_DEMUXER_aac
	bool "AAC"
	select FFMPEG_CUSTOM_PARSER_aac 

config FFMPEG_CUSTOM_DEMUXER_flv
	bool "FLV"

config FFMPEG_CUSTOM_DEMUXER_avi
	bool "AVI (Audio Video Interleave)"

config FFMPEG_CUSTOM_DEMUXER_ac3
	bool "AC3"

config FFMPEG_CUSTOM_DEMUXER_amr
	bool "AMR"

config FFMPEG_CUSTOM_DEMUXER_ape
	bool "APE"

config FFMPEG_CUSTOM_DEMUXER_flac
	bool "FLAC"

config FFMPEG_CUSTOM_DEMUXER_ffm
	bool "FFM (ffserver live feed)"

config FFMPEG_CUSTOM_DEMUXER_h264
	bool "H.264"
	depends on FFMPEG_CUSTOM_PATENTED

config FFMPEG_CUSTOM_DEMUXER_matroska
	bool "Matroska (MKA,MKV)"
	select FFMPEG_CUSTOM_DECODER_zlib

config FFMPEG_CUSTOM_DEMUXER_mov
	bool "MOV/MP4/M4A/3GP/3G2/MJ2"
	select FFMPEG_CUSTOM_DECODER_zlib

config FFMPEG_CUSTOM_DEMUXER_mp3
	bool "MP3 (MPEG Audio Layer 3)"
	select FFMPEG_CUSTOM_PARSER_mpegaudio

config FFMPEG_CUSTOM_DEMUXER_mpegvideo
	bool "MPEG Video"

config FFMPEG_CUSTOM_DEMUXER_mpegps
	bool "MPEG-2 (PS)"

config FFMPEG_CUSTOM_DEMUXER_mpegts
	bool "MPEG-2 (TS)"

config FFMPEG_CUSTOM_DEMUXER_mpc
	bool "Musepack"

config FFMPEG_CUSTOM_DEMUXER_mpc8
	bool "Musepack 8"

config FFMPEG_CUSTOM_DEMUXER_ogg
	bool "Ogg"

config FFMPEG_CUSTOM_DEMUXER_pcm_s16le
	bool "s16le demuxer"

config FFMPEG_CUSTOM_DEMUXER_pcm_s16be
	bool "s16be demuxer"

config FFMPEG_CUSTOM_DEMUXER_rm
	bool "RM"
	help
	  RealMedia format demuxer

config FFMPEG_CUSTOM_DEMUXER_rtsp
	bool "RTSP"
	select FFMPEG_CUSTOM_DEMUXER_rm
	select FFMPEG_CUSTOM_DEMUXER_sdp
	select FFMPEG_CUSTOM_DEMUXER_rtp

config FFMPEG_CUSTOM_DEMUXER_sdp
	bool "SDP"
	select FFMPEG_CUSTOM_DEMUXER_mpegts

config FFMPEG_CUSTOM_DEMUXER_rtp
	bool "RTP"

config FFMPEG_CUSTOM_DEMUXER_wav
	bool "WAV"

config FFMPEG_CUSTOM_DEMUXER_hls
	bool "HLS"
	
config FFMPEG_CUSTOM_DEMUXER_xwma
	bool "XWMA"

comment "Parsers ---"
config FFMPEG_CUSTOM_PARSER_aac
	bool "AAC (Advanced Audio Coding)"
	depends on FFMPEG_CUSTOM_PATENTED
	
config FFMPEG_CUSTOM_PARSER_aac_latm
	bool "AAC_LATM"

config FFMPEG_CUSTOM_PARSER_mjpeg
	bool "mjpeg"

config FFMPEG_CUSTOM_PARSER_flv
	bool "FLV"

config FFMPEG_CUSTOM_PARSER_ac3
	bool "AC3"

config FFMPEG_CUSTOM_PARSER_flac
	bool "FLAC"

config FFMPEG_CUSTOM_PARSER_h264
	bool "H.264"
	depends on FFMPEG_CUSTOM_PATENTED
	select FFMPEG_CUSTOM_DECODER_h264

config FFMPEG_CUSTOM_PARSER_mpegaudio
	bool "MPEG Audio"

config FFMPEG_CUSTOM_PARSER_mpegvideo
	bool "MPEG Video"

config FFMPEG_CUSTOM_PARSER_mpeg4video
	bool "MPEG-4 Video"

config FFMPEG_CUSTOM_PARSER_cook
	bool "cook"
	
config FFMPEG_CUSTOM_PARSER_vorbis
	bool "vorbis"
	
config FFMPEG_CUSTOM_PARSER_opus
	bool "Opus"

comment "Protocols ---"

config FFMPEG_CUSTOM_PROTOCOL_file
	bool "file:"

config FFMPEG_CUSTOM_PROTOCOL_hls
	bool "hls"

config FFMPEG_CUSTOM_PROTOCOL_http
	bool "http:"
	
config FFMPEG_CUSTOM_PROTOCOL_https
	bool "https:"
	
config FFMPEG_CUSTOM_PROTOCOL_httpproxy
	bool "httpproxy:"

config FFMPEG_CUSTOM_PROTOCOL_pipe
	bool "pipe:"

config FFMPEG_CUSTOM_PROTOCOL_rtp
	bool "rtp:"
	select FFMPEG_CUSTOM_PROTOCOL_udp

config FFMPEG_CUSTOM_PROTOCOL_tcp
	bool "tcp:"

config FFMPEG_CUSTOM_PROTOCOL_udp
	bool "udp:"

comment "Filters ---"

config FFMPEG_CUSTOM_FILTER_copy
	bool "copy"
	
config FFMPEG_CUSTOM_FILTER_aresample
	bool "aresample"	
	
config FFMPEG_CUSTOM_filter_avresample
	bool "avresample"
	
comment "Indevs ---"

config FFMPEG_CUSTOM_INDEV_v4l2
	bool "v4l2"

config FFMPEG_CUSTOM_INDEV_alsa
	bool "alsa"

endmenu
```

## panther_sdk/openwrt/package/legacy/upmpdcli/Config.in
```kconfig
config PACKAGE_UPMPDCLI_SCCTL
	bool "scctl command for configuring SongCast receivers"
	default no
	depends on PACKAGE_upmpdcli
	help
		Installs the scctl command. See the following link for more info: 
		http://www.lesbonscomptes.com/upmpdcli/scmulti.html

config PACKAGE_UPMPDCLI_SC_WEB_INTERFACE
	bool "SongCast web server and associated files (depends on python)"
	default no
	depends on PACKAGE_upmpdcli
	select PACKAGE_python
	select PACKAGE_UPMPDCLI_SCCTL
	help
		Installs the SongCast web interface and web server. See the following
		link for more info: http://www.lesbonscomptes.com/upmpdcli/scmulti.html

choice
	prompt "Select upmpdcli version"
	default PACKAGE_UPMPDCLI_0_6_4

config PACKAGE_UPMPDCLI_0_6_4
	bool "Using old version (0.6.4) but verified"
	default yes
	depends on PACKAGE_upmpdcli
	help
		Using old version upmpdcli, but verified.

config PACKAGE_UPMPDCLI_1_1_3
	bool "Using latest version (1.1.3) but not verified"
	default no
	depends on PACKAGE_upmpdcli
	help
		Using latest version upmpdcli, but not verified.
endchoice
```

## panther_sdk/openwrt/package/montage.bak/cdb/Config.in
```kconfig
menu "Change CDB Default Value"
depends on PACKAGE_cdb

config CDB_SSID_NAME
   string "WLAN AP SSID NAME"
   default "Demo_AP"

config CDB_SSID_SUFFIX_MACNUM
   int "SSID SUFFIX MAC num (Range:1-6)"
   range 1 6
   default	3

endmenu
```

## panther_sdk/openwrt/package/montage.bak/monitor/Config.in
```kconfig
menu "Support Input device" 
depends on PACKAGE_monitor

config MONITOR_GPIO_INPUTDEV
	bool "Monitor gpio input device"

config MONITOR_MADC_INPUTDEV
	bool "Monitor madc input device"

endmenu
```
